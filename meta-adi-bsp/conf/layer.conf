## meta-adi-bsp/conf/layer.conf
```bitbake
# We have a conf and classes directory, add to BBPATH
BBPATH .= ":${LAYERDIR}"

# We have recipes-* directories, add to BBFILES
BBFILES += "${LAYERDIR}/recipes-*/*/*.bb \
            ${LAYERDIR}/recipes-*/*/*.bbappend"

BBFILE_COLLECTIONS += "adi-bsp"
BBFILE_PATTERN_adi-bsp = "^${LAYERDIR}/"
BBFILE_PRIORITY_adi-bsp = "6"

LAYERDEPENDS_adi-bsp = "core"
LAYERSERIES_COMPAT_adi-bsp = "sumo thud warrior"
```

## meta-adi-core/conf/layer.conf
```bitbake
# We have a conf and classes directory, add to BBPATH
BBPATH .= ":${LAYERDIR}"

# We have recipes-* directories, add to BBFILES
BBFILES += "${LAYERDIR}/recipes-*/*/*.bb \
	${LAYERDIR}/recipes-*/*/*.bbappend"

BBFILE_COLLECTIONS += "adi-core"
BBFILE_PATTERN_adi-core = "^${LAYERDIR}/"
BBFILE_PRIORITY_adi-core = "6"

LAYERSERIES_COMPAT_adi-core = "rocko sumo thud warrior"

LAYERDEPENDS_adi-core = "core"

# Additional license directories.
LICENSE_PATH += "${LAYERDIR}/files/custom-licenses"
```

## meta-adi-xilinx/conf/layer.conf
```bitbake
# We have a conf and classes directory, add to BBPATH
BBPATH .= ":${LAYERDIR}"

# We have recipes-* directories, add to BBFILES
BBFILES += "${LAYERDIR}/recipes-*/*/*.bb \
	${LAYERDIR}/recipes-*/*/*.bbappend"

BBFILE_COLLECTIONS += "adi-xilinx"
BBFILE_PATTERN_adi-xilinx = "^${LAYERDIR}/"
BBFILE_PRIORITY_adi-xilinx = "8"

# the one used in petalinux 2025.1
LAYERSERIES_COMPAT_adi-xilinx = "scarthgap"

LAYERDEPENDS_adi-xilinx = "core"
LAYERDEPENDS_adi-xilinx += "xilinx"
LAYERDEPENDS_adi-xilinx += "xilinx-tools"
LAYERDEPENDS_adi-xilinx += "openembedded-layer"

BBFILES_DYNAMIC += " \
    petalinux:${LAYERDIR}/dynamic-layers/meta-petalinux/*/*/*.bb \
    petalinux:${LAYERDIR}/dynamic-layers/meta-petalinux/*/*/*.bbappend \
"

# Additional license directories.
LICENSE_PATH += "${LAYERDIR}/files/custom-licenses"
```
