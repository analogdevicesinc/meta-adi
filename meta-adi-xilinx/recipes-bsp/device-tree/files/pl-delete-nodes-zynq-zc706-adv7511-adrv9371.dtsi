/*Delete nodes from pl.dtsi which are redefined in ADI dts*/
/ {
	/delete-node/ aliases;
};

/delete-node/ &axi_ad9371_rx_clkgen;
/delete-node/ &axi_ad9371_rx_dma;
/delete-node/ &axi_ad9371_rx_jesd_rx_axi;
/delete-node/ &axi_ad9371_rx_os_clkgen;
/delete-node/ &axi_ad9371_rx_os_dma;
/delete-node/ &axi_ad9371_rx_os_jesd_rx_axi;
/delete-node/ &axi_ad9371_rx_os_xcvr;
/delete-node/ &axi_ad9371_rx_xcvr;
/delete-node/ &axi_ad9371_tx_clkgen;
/delete-node/ &axi_ad9371_tx_dma;
/delete-node/ &axi_ad9371_tx_jesd_tx_axi;
/delete-node/ &axi_ad9371_tx_xcvr;
/delete-node/ &axi_hdmi_clkgen;
/delete-node/ &axi_hdmi_core;
/delete-node/ &axi_hdmi_dma;
/delete-node/ &axi_iic_main;
/delete-node/ &axi_spdif_tx_core;
