/*Delete nodes from pl.dtsi which are redefined in ADI dts*/
/ {
	/delete-node/ aliases;
};

/delete-node/ &axi_ad6676_core;
/delete-node/ &axi_ad6676_dma;
/delete-node/ &axi_ad6676_jesd_rx_axi;
/delete-node/ &axi_ad6676_xcvr;
/delete-node/ &axi_hdmi_clkgen;
/delete-node/ &axi_hdmi_core;
/delete-node/ &axi_hdmi_dma;
/delete-node/ &axi_iic_main;
/delete-node/ &axi_spdif_tx_core;
