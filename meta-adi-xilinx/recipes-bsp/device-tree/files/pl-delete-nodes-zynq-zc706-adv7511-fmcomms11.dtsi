/*Delete nodes from pl.dtsi which are redefined in ADI dts*/
/ {
	/delete-node/ aliases;
};

/delete-node/ &axi_ad9162_dma;
/delete-node/ &axi_ad9162_jesd_tx_axi;
/delete-node/ &axi_ad9162_xcvr;
/delete-node/ &axi_ad9625_dma;
/delete-node/ &axi_ad9625_jesd_rx_axi;
/delete-node/ &axi_ad9625_xcvr;
/delete-node/ &axi_hdmi_clkgen;
/delete-node/ &axi_hdmi_core;
/delete-node/ &axi_hdmi_dma;
/delete-node/ &axi_iic_main;
/delete-node/ &axi_spdif_tx_core;
/delete-node/ &axi_ad9162_core;
/delete-node/ &axi_ad9625_core;