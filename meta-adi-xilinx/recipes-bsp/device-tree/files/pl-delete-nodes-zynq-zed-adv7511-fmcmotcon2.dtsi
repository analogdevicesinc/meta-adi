/*Delete nodes from pl.dtsi which are redefined in ADI dts*/
/ {
	/delete-node/ aliases;
};

/delete-node/ &axi_hdmi_clkgen;
/delete-node/ &axi_hdmi_core;
/delete-node/ &axi_hdmi_dma;
/delete-node/ &axi_i2s_adi;
/delete-node/ &axi_iic_fmc;
/delete-node/ &axi_iic_main;
/delete-node/ &axi_spdif_tx_core;
/delete-node/ &controller_m1;
/delete-node/ &controller_m2;
/delete-node/ &current_monitor_m1;
/delete-node/ &current_monitor_m1_dma;
/delete-node/ &current_monitor_m2;
/delete-node/ &current_monitor_m2_dma;
/delete-node/ &iic_ee2;
/delete-node/ &speed_detector_m1;
/delete-node/ &speed_detector_m1_dma;
/delete-node/ &speed_detector_m2;
/delete-node/ &speed_detector_m2_dma;
/delete-node/ &xadc_core;
